## iot-frontend/iot-code-main/iot-code-espressif/sdkconfig.defaults
```kconfig
# ESP32-S3 Camera Streaming Configuration

#
# WiFi Configuration
#
CONFIG_WIFI_SSID="YOUR_WIFI_SSID"
CONFIG_WIFI_PASSWORD="YOUR_WIFI_PASSWORD"

#
# Camera Configuration
#
CONFIG_CAMERA_MODEL_ESP32S3_EYE=y
CONFIG_CAMERA_MODULE_OV5640=y

#
# ESP32S3-Specific Configurations
#
CONFIG_ESP32S3_SPIRAM_SUPPORT=y
CONFIG_SPIRAM_MODE_OCT=y
CONFIG_SPIRAM_TYPE_AUTO=y
CONFIG_SPIRAM_SIZE_AUTO=y
CONFIG_SPIRAM_SPEED_80M=y
CONFIG_SPIRAM_BOOT_INIT=y
CONFIG_SPIRAM_IGNORE_NOTFOUND=y
CONFIG_SPIRAM_USE_MEMMAP=y
CONFIG_SPIRAM_MEMTEST=y
CONFIG_SPIRAM_MALLOC_ALWAYSINTERNAL=16384
CONFIG_SPIRAM_MALLOC_RESERVE_INTERNAL=32768

#
# Memory Configuration
#
CONFIG_ESP_MAIN_TASK_STACK_SIZE=8192
CONFIG_ESP_MAIN_TASK_AFFINITY_CPU0=y
CONFIG_ESP_SYSTEM_EVENT_TASK_STACK_SIZE=4096
CONFIG_ESP_TIMER_TASK_STACK_SIZE=4096

#
# FreeRTOS Configuration
#
CONFIG_FREERTOS_UNICORE=n
CONFIG_FREERTOS_HZ=1000
CONFIG_FREERTOS_USE_TRACE_FACILITY=y
CONFIG_FREERTOS_USE_STATS_FORMATTING_FUNCTIONS=y
CONFIG_FREERTOS_TASK_FUNCTION_WRAPPER=y

#
# WiFi Configuration
#
CONFIG_ESP32_WIFI_AMPDU_TX_ENABLED=y
CONFIG_ESP32_WIFI_AMPDU_RX_ENABLED=y
CONFIG_ESP32_WIFI_NVS_ENABLED=y
CONFIG_ESP32_WIFI_TASK_PINNED_TO_CORE_0=y
CONFIG_ESP32_WIFI_SOFTAP_BEACON_MAX_LEN=752
CONFIG_ESP32_WIFI_MGMT_SBUF_NUM=32
CONFIG_ESP32_WIFI_IRAM_OPT=y
CONFIG_ESP32_WIFI_RX_IRAM_OPT=y

#
# HTTP Client Configuration
#
CONFIG_ESP_HTTP_CLIENT_ENABLE_HTTPS=y
CONFIG_ESP_HTTP_CLIENT_ENABLE_BASIC_AUTH=y

#
# Logging Configuration
#
CONFIG_LOG_DEFAULT_LEVEL_INFO=y
CONFIG_LOG_DEFAULT_LEVEL=3
CONFIG_LOG_MAXIMUM_EQUALS_DEFAULT=y

#
# Camera Component Configuration
#
CONFIG_CAMERA_CORE0=n
CONFIG_CAMERA_CORE1=y
CONFIG_CAMERA_DMA_BUFFER_SIZE_MAX=32768

#
# Performance Optimizations
#
CONFIG_COMPILER_OPTIMIZATION_PERF=y
CONFIG_ESP32S3_DEFAULT_CPU_FREQ_240=y
CONFIG_ESP32S3_INSTRUCTION_CACHE_8KB=y
CONFIG_ESP32S3_DATA_CACHE_64KB=y
CONFIG_ESP32S3_INSTRUCTION_CACHE_LINE_32B=y
CONFIG_ESP32S3_DATA_CACHE_LINE_64B=y

#
# Ethernet (disabled to save resources)
#
CONFIG_ETH_ENABLED=n

#
# Bluetooth (disabled to save resources) 
#
CONFIG_BT_ENABLED=n

#
# Power Management
#
CONFIG_PM_ENABLE=n
```
